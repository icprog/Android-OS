## Android OS 源码/Android8.1_39O指纹源码新/kernel-4.4/drivers/input/fingerprint/blestech/Kconfig
```kconfig
config BETTERLIFE_FINGERPRINT
	bool "BETTERLIFE_FINGERPRINT"
	default n
	help
	  Kernel space cdfinger version 3.1, FPS998 FPS998E FPS980 FPS956 driver.
```

## Android OS 源码/Android8.1_39O指纹源码新/kernel-4.4/drivers/input/fingerprint/cdfinger_v31/Kconfig
```kconfig
config FINGERPRINT_MTK_CDFINGER_V31
	bool "CONFIG_FINGERPRINT_MTK_CDFINGER_V31"
	default n
	help
	  Kernel space cdfinger version 3.1, FPS998 FPS998E FPS980 FPS956 driver.
```

## Android OS 源码/Android8.1_39O指纹源码新/kernel-4.4/drivers/input/fingerprint/chipsailing_tee/Kconfig
```kconfig
config BIRD_FINGERPRINT_CHIPSAILING_TEE
	bool "CONFIG_BIRD_FINGERPRINT_CHIPSAILING_TEE chipsailing for Mediatek package SC338P"
	default n     
```

## Android OS 源码/Android8.1_39O指纹源码新/kernel-4.4/drivers/input/fingerprint/icnt7152/Kconfig
```kconfig
config BIRD_FINGERPRINT_ICNT7152
	tristate "CONFIG_BIRD_FINGERPRINT_ICNT7152  chipone FP spi deriver"
        depends on SPI
	default n
	help
	  Say Y here to use silead fingerprint driver.

	  If unsure, say N.
```

## Android OS 源码/Android8.1_39O指纹源码新/kernel-4.4/drivers/input/fingerprint/microarray_fp_v4006/Kconfig
```kconfig
# Copyright (C) MicroArray  
# MicroArray Fprint Driver Code
# Kconfig
# Date: 2017-3-15
# Version: v4.0.06
# Author: guq
# Contact: guq@microarray.com.cn

config BIRD_FINGERPRINT_MICROARRAY_FP_V4006
	bool "CONFIG_BIRD_FINGERPRINT_MICROARRAY_FP_V4006 A118N microarray fp for Mediatek package"
	default n
        ---help---
          A118N fp sensor  for MT6739 with dts       
```

## Android OS 源码/Android8.1_39O指纹源码新/kernel-4.4/drivers/input/fingerprint/sunwave_tee/Kconfig
```kconfig
config MTK_FINGERPRINT_SUNWAVECORP
       bool "Sunwave Fingerprint"
       default n
       help
          SUNWAVECORP Fingerprint
```

## Android OS 源码/Android8.1_39O指纹源码新/kernel-4.4/drivers/input/fingerprint/sunwavecorp_v111/Kconfig
```kconfig
menu "sunwavecorp sensor Device"

menuconfig SUNWAVECORP
        tristate "sunwavecorp fp sensor "
        default y
        ---help---
          Say Y here for supporting sunwavecorp sensor

if SUNWAVECORP

choice
	prompt "sunwavecorp sensor for"
	default SUNWAVECORP_MT6797  

config SUNWAVECORP_MT6797
        bool " MT6797 with dts"
        default y
        ---help---
          sunwavecorp sensor for MT6797 with dts          
endchoice

endif

endmenu

config  FINGERPRINT_MTK_SUNWAVECORP_V111
	bool "CONFIG_FINGERPRINT_MTK_SUNWAVECORP_V111 V1.1.1.20170425 Support: sw5318b..."
	default n
```
